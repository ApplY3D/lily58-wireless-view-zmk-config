## config/west.yml
```yaml
manifest:
  remotes:
    - name: zmkfirmware
      url-base: https://github.com/zmkfirmware
    - name: urob
      url-base: https://github.com/urob
    - name: ApplY3D
      url-base: https://github.com/ApplY3D
  projects:
    - name: zmk
      remote: ApplY3D
      revision: main
      import: app/west.yml
  self:
    path: config
```
